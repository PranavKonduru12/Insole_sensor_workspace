## BLE_6adc_imu_power_save/build/peripheral_uart_file_6adc_imu/Kconfig/boards/Kconfig.adafruit_feather_nrf52840
```kconfig
# Load board Kconfig descriptions.
osource "C:/ncs/v3.4.0/zephyr/boards/adafruit/feather_nrf52840/Kconfig.adafruit_feather_nrf52840"
```

## BLE_6adc_imu_power_save/build_no_ble_serial/Kconfig/boards/Kconfig.defconfig.tmp
```kconfig
# Load Zephyr board defconfig descriptions.
osource "C:/ncs/v3.4.0/zephyr/boards/adafruit/feather_nrf52840/Kconfig.defconfig"
```
